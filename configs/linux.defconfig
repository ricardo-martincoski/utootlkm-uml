## configs/linux.defconfig
```kconfig
CONFIG_BLK_DEV_INITRD=y
CONFIG_MODULES=y
# CONFIG_UNUSED_SYMBOLS is not set
CONFIG_BLK_DEV_LOOP=m
CONFIG_MD=y
CONFIG_STACKTRACE=y
CONFIG_KUNIT=y
CONFIG_KUNIT_TEST=m
```

## configs/linux_download_defconfig
```kconfig
BR2_x86_64=y
BR2_DL_DIR="../download"
BR2_STATIC_LIBS=y
BR2_TOOLCHAIN_EXTERNAL=y
BR2_TOOLCHAIN_EXTERNAL_BOOTLIN_X86_64_UCLIBC_STABLE=y
BR2_LINUX_KERNEL=y
BR2_LINUX_KERNEL_CUSTOM_VERSION=y
BR2_LINUX_KERNEL_CUSTOM_VERSION_VALUE="5.10.165"
BR2_LINUX_KERNEL_DEFCONFIG="none"
# BR2_PACKAGE_IFUPDOWN_SCRIPTS is not set
BR2_TARGET_ROOTFS_CPIO=y
```

## configs/rootfs_defconfig
```kconfig
BR2_x86_64=y
BR2_STATIC_LIBS=y
BR2_TOOLCHAIN_EXTERNAL=y
BR2_TOOLCHAIN_EXTERNAL_BOOTLIN_X86_64_UCLIBC_STABLE=y
BR2_DL_DIR="../download"
# BR2_PACKAGE_IFUPDOWN_SCRIPTS is not set
BR2_TARGET_ROOTFS_CPIO=y
```
